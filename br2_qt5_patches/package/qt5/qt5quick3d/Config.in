## br2_qt5_patches/package/qt5/qt5quick3d/Config.in
```kconfig
config BR2_PACKAGE_QT5QUICK3D
	bool "qt5quick3d"
	depends on BR2_PACKAGE_QT5_JSCORE_AVAILABLE
	depends on BR2_PACKAGE_QT5_GL_AVAILABLE
	select BR2_PACKAGE_QT5DECLARATIVE
	select BR2_PACKAGE_QT5DECLARATIVE_QUICK
	help
	  Qt Quick 3D module. Provides a high-level API for creating
	  3D content integrated into Qt Quick scenes.

	  https://doc.qt.io/qt-5/qtquick3d-index.html
```

## br2_qt6_patches/package/qt6/qt6declarative/Config.in
```kconfig
config BR2_PACKAGE_QT6DECLARATIVE
	bool "qt6declarative"
	select BR2_PACKAGE_QT6BASE_GUI
	help
	  Qt is a cross-platform application and UI framework for
	  developers using C++.

	  Qt Declarative provides the Qt QML and Qt Quick modules for
	  developing UIs and applications with the QML language.
	  Also provides Qt Quick Controls 2.

	  https://doc.qt.io/qt-6/qtqml-index.html
	  https://doc.qt.io/qt-6/qtquick-index.html
```

## br2_qt6_patches/package/qt6/qt6multimedia/Config.in
```kconfig
config BR2_PACKAGE_QT6MULTIMEDIA
	bool "qt6multimedia"
	depends on BR2_PACKAGE_QT6DECLARATIVE
	select BR2_PACKAGE_QT6BASE_GUI
	select BR2_PACKAGE_QT6BASE_NETWORK
	help
	  Qt is a cross-platform application and UI framework for
	  developers using C++.

	  Qt Multimedia provides a rich feature set for handling
	  multimedia content including audio, video, and camera
	  functionality.

	  https://doc.qt.io/qt-6/qtmultimedia-index.html

comment "qt6multimedia needs qt6declarative"
	depends on !BR2_PACKAGE_QT6DECLARATIVE
```

## br2_qt6_patches/package/qt6/qt6quick3d/Config.in
```kconfig
config BR2_PACKAGE_QT6QUICK3D
	bool "qt6quick3d"
	depends on BR2_PACKAGE_QT6DECLARATIVE
	depends on BR2_PACKAGE_QT6SHADERTOOLS
	depends on BR2_PACKAGE_QT6_GL_SUPPORTS
	select BR2_PACKAGE_QT6BASE_GUI
	select BR2_PACKAGE_QT6BASE_CONCURRENT
	help
	  Qt is a cross-platform application and UI framework for
	  developers using C++.

	  Qt Quick 3D provides a high-level API for creating 3D content
	  and 3D user interfaces based on Qt Quick. It extends the Qt
	  Quick scene graph with spatial content and provides a way to
	  mix 2D and 3D content.

	  https://doc.qt.io/qt-6/qtquick3d-index.html

comment "qt6quick3d needs qt6declarative, qt6shadertools and OpenGL"
	depends on !BR2_PACKAGE_QT6DECLARATIVE || !BR2_PACKAGE_QT6SHADERTOOLS || \
		!BR2_PACKAGE_QT6_GL_SUPPORTS
```

## br2_qt6_patches/package/qt6/qt6shadertools/Config.in
```kconfig
config BR2_PACKAGE_QT6SHADERTOOLS
	bool "qt6shadertools"
	help
	  Qt is a cross-platform application and UI framework for
	  developers using C++.

	  Qt Shader Tools provides the 'qsb' command-line tool and
	  associated libraries for building cross-platform Qt shader
	  pipelines. Required by Qt Quick 3D.

	  https://doc.qt.io/qt-6/qtshadertools-index.html
```
